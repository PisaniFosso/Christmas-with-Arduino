#include <Playtune.h> //Librairie qui permet de lire les tones


// Playtune bytestream for file "jingle_bells.mid" created by MIDITONES V1.6 on Thu Nov 16 11:43:09 2017
// command line: miditonesV1.6.exe -t3 jingle_bells 
const PROGMEM byte jingle_bells [] = {
// s7267
0x90,62, 0x91,50, 0x92,62, 1,44, 0x80, 0x81, 0x82, 0x90,71, 0x91,59, 0x92,62, 1,44, 0x80, 0x81, 
0x82, 0x90,69, 0x91,57, 0x92,62, 1,44, 0x80, 0x81, 0x82, 0x90,67, 0x91,55, 0x92,62, 1,44, 0x80, 
0x81, 0x82, 0x90,62, 0x91,50, 0x92,62, 2,88, 0x80, 0x81, 0x82, 0x90,38, 1,44, 0x91,62, 0x92,50, 
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0x80, 0x81, 0x82, 0xf0};
// This score contains 1135 bytes, and 3 tone generators are used.
// 145 notes had to be skipped.


// Playtune bytestream for file "Christmas_Carols_-_12_Days_Of_Christmas.mid" created by MIDITONES V1.6 on Thu Nov 16 10:20:52 2017
// command line: miditonesV1.6.exe -t3 Christmas_Carols_-_12_Days_Of_Christmas 
const PROGMEM byte Christmas_Carols_12_Days_Of_Christmas [] = {
// untitled
5,53, 0x90,72, 0x91,72, 0x92,72, 0,218, 0x80, 0x81, 0x82, 0,3, 0x90,72, 0x91,72, 0x92,72, 
0,218, 0x80, 0x81, 0x82, 0,3, 0x90,69, 0x91,72, 0x92,72, 1,188, 0x81, 0x82, 0x91,77, 0x92,77, 
0,218, 0x81, 0x82, 0,3, 0x91,77, 0x92,77, 0,218, 0x81, 0x82, 0,3, 0x80, 0x90,77, 0x91,77, 
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0x80, 0x81, 0x82, 0x90,77, 0x91,77, 0x92,77, 2,100, 7,44, 0x80, 0x81, 0x82, 0xf0};
// This score contains 1892 bytes, and 3 tone generators are used.
// 389 notes had to be skipped.


Playtune pt; // instanciation de la classe Playtune 

// Déclaration de variables
const int soundPin = A0; //sound sensor attach to A0
int choice = 0;

//initialisation des pins qui seront utilisées
void setup() {    
  Serial.begin(9600); //initialisation serial 
  pt.tune_initchan (10); //appel de ma méthode tune_initchan de la class Playtune regle le timer sur la pin de sortie
   
   //optionnel vue que le fichier sort 3 differente notes
   pt.tune_initchan (11); 
    pt.tune_initchan (9);
}

void loop() { 
    
  int value = analogRead(soundPin);//lit la valeur de la pin A0
  Serial.println(value);//Affiche la value sur le moniteur value

 /*si la valeur est supérieu à 200 
  faire jouer une musique */
    if (value < 200) 
    {
      /*lorsque choice = 0
      faire chanter le titre jingle_bells
      la methode */
    if(choice == 0)
    {pt.tune_playscore (jingle_bells); //commence à jouer et le tone qui se trouve dans jingle_bells
   while( pt.tune_playing );  
    delay(200);//delay 200ms
    choice++;}
    /*sinon si choice = 1
      faire chanter le titre Christmas_Carols_12_Days_Of_Christmas 
      et reinitialiser choice à 0 pour que la prochaine fois que le button es préssé on re tombe sur la chnson jingle_bells*/
   else if ( choice ==1)
  {
      pt.tune_playscore (Christmas_Carols_12_Days_Of_Christmas); //commence à jouer et le tone qui se trouve dans jingle_bells
   while( pt.tune_playing );  
    delay(200);//delay 200ms
    choice = 0;
    }

 /*Sinon stoper le tune qui jouait*/
 else{
        pt.tune_stopscore(); 
    }
   
}
}
 

